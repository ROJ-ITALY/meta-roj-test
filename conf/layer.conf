## conf/layer.conf
```bitbake
# We have a conf and classes directory, add to BBPATH
BBPATH .= ":${LAYERDIR}"

# We have recipes-* directories, add to BBFILES
BBFILES += "${LAYERDIR}/recipes-*/*/*.bb \
	${LAYERDIR}/recipes-*/*/*.bbappend"

BBFILE_COLLECTIONS += "vdw-distro-ce"
BBFILE_PATTERN_vdw-distro-ce = "^${LAYERDIR}/"
BBFILE_PRIORITY_vdw-distro-ce = "10"

LAYERSERIES_COMPAT_vdw-distro-ce = "hardknott"
```

## conf/machine/imx6qce.conf
```bitbake
#@TYPE: Machine
#@NAME: SMARC i.MX6Quad CE Controller
#@SOC: i.MX6S
#@DESCRIPTION: Machine configuration for SMARC i.MX6Quad CE Controller
#@MAINTAINER: Stefano Gurrieri <stefano.gurrieri@roj.com>

MACHINEOVERRIDES =. "mx6:mx6q:"

require conf/machine/include/imx6ce-common.inc

KERNEL_DEVICETREE = "020100.dtb 020101.dtb 020102.dtb"

PREFERRED_PROVIDER_u-boot = "u-boot-imx"
PREFERRED_PROVIDER_virtual/bootloader = "u-boot-imx"
PREFERRED_PROVIDER_virtual/kernel = "linux-imx"
KERNEL_IMAGETYPE = "zImage"

UBOOT_CONFIG ??= "sd"
UBOOT_CONFIG[sd] = "mx6qce_config,sdcard"
UBOOT_CONFIG[mfgtool] = "mx6qce_config"
```

## conf/machine/imx6soloce.conf
```bitbake
#@TYPE: Machine
#@NAME: SMARC i.MX6Solo CE Controller
#@SOC: i.MX6S
#@DESCRIPTION: Machine configuration for SMARC i.MX6Solo CE Controller
#@MAINTAINER: Stefano Gurrieri <stefano.gurrieri@roj.com>

MACHINEOVERRIDES =. "mx6:mx6dl:"

require conf/machine/include/imx6ce-common.inc

KERNEL_DEVICETREE = "010100.dtb 010101.dtb 010102.dtb"

PREFERRED_PROVIDER_u-boot = "u-boot-imx"
PREFERRED_PROVIDER_virtual/bootloader = "u-boot-imx"
PREFERRED_PROVIDER_virtual/kernel = "linux-imx"
KERNEL_IMAGETYPE = "zImage"

UBOOT_CONFIG ??= "sd"
UBOOT_CONFIG[sd] = "mx6dlce_config,sdcard"
UBOOT_CONFIG[mfgtool] = "mx6dlce_config"
```
